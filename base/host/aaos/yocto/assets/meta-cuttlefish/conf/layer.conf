## base/host/aaos/yocto/assets/meta-cuttlefish/conf/layer.conf
```bitbake
# Copyright 2025 Android Open Source Project
# SPDX-License-Identifier: MIT

BBPATH .= ":${LAYERDIR}"
BBFILES += "${LAYERDIR}/recipes-*/*/*.bb \
            ${LAYERDIR}/recipes-*/*/*.bbappend"

BBFILE_COLLECTIONS += "meta-cuttlefish"
BBFILE_PATTERN_meta-cuttlefish = "^${LAYERDIR}/"

# Highest layer priority
BBFILE_PRIORITY_meta-cuttlefish = "11"
LAYERSERIES_COMPAT_meta-cuttlefish = "scarthgap"
```
